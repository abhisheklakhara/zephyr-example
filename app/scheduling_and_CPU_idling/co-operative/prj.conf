## CMakeLists.txt
```
cmake_minimum_required(VERSION 3.20.0)
find_package(Zephyr REQUIRED HINTS $ENV{ZEPHYR_BASE})
project(k_yeild)

target_sources(app PRIVATE src/main.c)
```

## prj.conf
```kconfig
# Enable basic threading
CONFIG_MAIN_STACK_SIZE=1024
CONFIG_THREAD_NAME=y

# Use simple scheduler (optional, works with others too)
CONFIG_SCHED_SIMPLE=y

# Enable printk for console output
CONFIG_PRINTK=y
```

## src/main.c
```c
#include <stdio.h>
#include <zephyr/kernel.h>


#define STACK_SIZE 512
#define PRIORITY 3  // Same priority for both threads

void thread1(void *a, void *b, void *c)
{
    while (1) {
        printk(" Thread 1 running\n");
       // k_yield();  // Yield to give Thread 2 a chance
    }
}

void thread2(void *a, void *b, void *c)
{
    while (1) {
        printk(" Thread 2 running\n");
        //k_yield();  // Yield to give Thread 1 a chance
    }

}

K_THREAD_STACK_DEFINE(stack1, STACK_SIZE);
K_THREAD_STACK_DEFINE(stack2, STACK_SIZE);
struct k_thread t1, t2;

void main(void)
{
    printk("Demo of k_yield()\n");

    k_thread_create(&t1, stack1, STACK_SIZE,
                    thread1, NULL, NULL, NULL,
                    PRIORITY, 0, K_NO_WAIT);

    k_thread_create(&t2, stack2, STACK_SIZE,
                    thread2, NULL, NULL, NULL,
                    PRIORITY, 0, K_NO_WAIT);
}
```
